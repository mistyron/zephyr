/*
 * Copyright (c) 2018 Daniel Wagenknecht
 *
 * Document the usage of /delete-node/ for device tree nodes
 * that are missing on only a small subset of SoCs of a given group
 * of SoCs.
 * Don't remove this file even if none of the SoCs currently
 * implemented in zephyr use it.
 *
 * spi5 and spi6 are present on all STM32F439XX SoCs except
 * STM32F439vX SoCs, so they are defined in stm32f439.dtsi and deleted
 * here.
 *
 * SPDX-License-Identifier: Apache-2.0
 */

#include <st/f4/stm32f439.dtsi>

/delete-node/ &spi5;

/delete-node/ &spi6;
