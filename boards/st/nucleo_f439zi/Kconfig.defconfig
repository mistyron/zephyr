## boards/st/nucleo_f439zi/Kconfig.defconfig
```kconfig
# NUCLEO-144 F439ZI board configuration

# Copyright (c) 2017 Linaro Limited
# SPDX-License-Identifier: Apache-2.0

if BOARD_NUCLEO_F439ZI

if NETWORKING

config NET_L2_ETHERNET
	default y

endif # NETWORKING

endif # BOARD_NUCLEO_F439ZI
```

## boards/st/nucleo_f439zi/Kconfig.nucleo_f439zi
```kconfig
# Copyright (c) 2017 Linaro Limited
# SPDX-License-Identifier: Apache-2.0

config BOARD_NUCLEO_F439ZI
	select SOC_STM32F439XX
```

## soc/st/stm32/stm32f4x/Kconfig.defconfig.stm32f439xx
```kconfig
# ST STM32F439XX MCU configuration options

# Copyright (c) 2016 Linaro Limited.
# SPDX-License-Identifier: Apache-2.0

if SOC_STM32F439XX

config NUM_IRQS
	default 91

endif # SOC_STM32F439XX
```
